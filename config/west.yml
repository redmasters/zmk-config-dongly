## config/west.yml
```yaml
manifest:
  defaults:
    remote: urob

  remotes:
    - name: urob
      url-base: https://github.com/urob
  projects:
    - name: zmk
      remote: urob
      revision: main
      import: app/west.yml

    - name: zmk-helpers
      revision: main
      path: modules/helpers

    - name: zmk
      revision: going-modular
      path: .
      import:
        file: app/west.yml
        path-prefix: zmk

  self:
    path: config
```
